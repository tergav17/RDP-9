/ RDP-9 EXTENDED MEMORY TEST

	/ SET UP LOWER MEMORY
	LAC ISR6
	DAC 21
	LAC ISR2
	DAC 22
	LAC ISR1
	DAC 23
	
	/ TEST LEM EEM
	LEM
	SEM
	JMP .+2
	HLT
	EEM
	SEM
	HLT
	
	/ MEMM DBR CONDITIONS
	
	/ DBR MEMM ON TO OFF
	LEM
	CAL
	SEM
	JMP .+2
	HLT
	
	/ DBR MEMM ON TO ON
	EEM
	CAL
	SEM
	HLT
	
	/ DBR MEMM OFF TO OFF
	LAC ISR5
	DAC 21
	LEM
	CAL
	SEM
	JMP .+2
	HLT
	
	/ DBR MEMM ON TO OFF
	EEM
	CAL
	SEM
	HLT
	
	/ SWITCH TO EMIR
	LAC ISR3
	DAC 22
	LAC ISR4
	DAC 21
	
	/ EMIR MEMM ON TO OFF
	LEM
	CAL
	SEM
	JMP .+2
	HLT
	EEM
	CAL
	SEM
	HLT
	
	/ TEST MEMORY READ/WRITE
	LEM
	LAC CON2
	DAC I PNTR0
	LAC CON3
	DAC I PNTR1
	
	LAC I PNTR0
	SAD CON3
	JMP .+2
	LAC I PNTR1
	SAD CON3
	JMP .+2
	HLT
	
	EEM
	LAC CON2
	DAC I PNTR0
	LAC CON3
	DAC I PNTR1
	
	LAC I PNTR0
	SAD CON2
	JMP .+2
	HLT
	LAC I PNTR1
	SAD CON3
	JMP .+2
	HLT
	
	/ DONE
	LAC CON1
	HLT
	
	
	
	
ISR1,	JMP I 20
ISR2,	DBR
ISR3,	EMIR
ISR4,	NOP
ISR5,	LEM
ISR6,	EEM

CON1,	777777
CON2,	123456
CON3,	654321


PNTR0,	17000
PNTR1,	37000
